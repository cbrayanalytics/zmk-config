/* Left half: 128x64 SSD1306 on I2C0 (SDA=P0.17, SCL=P0.20) */
&i2c0 {
    status = "okay";

    oled_left: ssd1306@3c {
        compatible = "solomon,ssd1306fb";
        reg = <0x3c>;
        width = <128>;
        height = <64>;
        segment-offset = <0>;
        page-offset = <0>;
        display-offset = <0>;
        multiplex-ratio = <63>;
        segment-remap;
        com-invdir;
        prechargep = <0x22>;
    };
};

/ {
    chosen {
        zephyr,display = &oled_left;
    };
};
